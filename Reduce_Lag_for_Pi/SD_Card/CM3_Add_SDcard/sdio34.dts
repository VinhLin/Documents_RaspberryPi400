/dts-v1/;
/plugin/;

/* Enable SDIO from MMC interface via GPIOs 34-39. Includes sdhost overlay. */

/{
	compatible = "brcm,bcm2835", "brcm,bcm2836", "brcm,bcm2708", "brcm,bcm2709";

	fragment@0 {
		target = <&mmc>;
		sdio_mmc: __overlay__ {
			pinctrl-names = "default";
			pinctrl-0 = <&sdio_pins>;
			non-removable;
			bus-width = <4>;
			brcm,overclock-50 = <0>;
			status = "okay";
		};
	};

	fragment@1 {
		target = <&gpio>;
		__overlay__ {
			sdio_pins: sdio_pins {
				brcm,pins = <34 35 36 37 38 39>;
				brcm,function = <7>; /* ALT3 = SD1 */
				brcm,pull = <0 2 2 2 2 2>;
			};
		};
	};

	__overrides__ {
		poll_once = <&sdio_mmc>,"non-removable?";
		bus_width = <&sdio_mmc>,"bus-width:0";
		sdio_overclock = <&sdio_mmc>,"brcm,overclock-50:0";
	};
};
